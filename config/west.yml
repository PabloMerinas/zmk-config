## config/west.yml
```yaml
manifest:
  remotes:
    - name: jediknil
      url-base: https://github.com/jediknil

  projects:
    - name: zmk
      remote: jediknil
      revision: display-timeout
      path: zmk
  self:
    path: config
```
